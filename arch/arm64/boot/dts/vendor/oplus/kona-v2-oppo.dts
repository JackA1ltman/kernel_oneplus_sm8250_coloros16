/dts-v1/;

#include "../qcom/kona-v2.dtsi"
#include "kona-oppo.dtsi"

/ {
	model = "Qualcomm Technologies, Inc. kona v2 SoC";
	compatible = "qcom,kona";
	qcom,board-id = <0 0>;
	oplus,dtsi_no = <20061 21615 21619>;
};
