/dts-v1/;

#include "../qcom/kona.dtsi"
#include "kona-oppo.dtsi"

/ {
	model = "Qualcomm Technologies, Inc. kona v1 SoC";
	compatible = "qcom,kona";
	qcom,board-id = <0 0>;
	oplus,dtsi_no = <20061 21615 21619>;
};
